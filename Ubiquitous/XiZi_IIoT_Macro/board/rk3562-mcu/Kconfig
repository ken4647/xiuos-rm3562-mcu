## Ubiquitous/XiZi_IIoT_Macro/board/rk3562-mcu/Kconfig
```kconfig
mainmenu "XiZi_IIoT Project Configuration"

config BSP_DIR
    string
    option env="BSP_ROOT"
    default "."

config KERNEL_DIR
    string
    option env="KERNEL_ROOT"
    default "../.."

config BOARD_RK3562_MCU
    bool
    select  ARCH_ARM
    default y

source "$KERNEL_DIR/arch/Kconfig"

menu "rk3562mcu feature"
    source "$BSP_DIR/third_party_driver/Kconfig"

endmenu


menu "Hardware feature"
source "$KERNEL_DIR/resources/Kconfig"
endmenu

source "$KERNEL_DIR/Kconfig"
```

## Ubiquitous/XiZi_IIoT_Macro/board/rk3562-mcu/third_party_driver/uart/Kconfig
```kconfig
menuconfig BSP_USING_UART9
    bool "Enable UART9"
    default y
    if BSP_USING_UART9
        config SERIAL_BUS_NAME_9
            string "serial bus 9 name"
            default "uart9"
        config SERIAL_DRV_NAME_9
            string "serial bus 9 driver name"
            default "uart9_drv"
        config SERIAL_9_DEVICE_NAME_0
                string "serial bus 9 device 0 name"
                default "uart9_dev0"   
    endif
```
